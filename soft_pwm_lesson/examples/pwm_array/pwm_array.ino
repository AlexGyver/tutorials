/*
    Работаем с каналами при помощи массивов!
    Программный ШИМ, любое разрешение до 8 бит, 5 каналов
    Выводим ШИМ на пины А0,A1,A2,А3,A4,A5
    Значение заполнения берем из генератора случайных чисел
*/

#include <GyverTimers.h>  // Либа прерываний по таймеру
#include "FastIO.h"       // Либа быстрого ввода/вывода

#define PWM_DEPTH 15      // Предел счета таймера, определяет разрешение ШИМ
// Можно выбрать от 2 до 254 (больше нельзя)
// В данном случае ШИМ имеет пределы 0 - 15 (4 бита, 16 градаций)


#define PWM_CHANNELS 5            // Вводим кол-во каналов ШИМ
volatile byte duty[PWM_CHANNELS]; // Переменные для хранения заполнения ШИМ
const byte pins[] = {A0, A1, A2, A3, A4}; // Перечисляем пины каналов ШИМ

void setup() {
  for (uint8_t i = 0; i < PWM_CHANNELS; i++) {  // Прогоняем все каналы
    pinMode(pins[i], OUTPUT);                   // Все каналы ШИМ устанавливаются как выходы
    duty[i] = 0;                                // И записываем нули в заполнение каждого
  }

  Timer2.setFrequency(40000);     // Заводим прерывания таймера 2 на 40кгц
  Timer2.enableISR();             // Вкл. прерывания таймера
}

void loop() { // Получаем заполнение ШИМ с генератора случайных чисел
  for (uint8_t i = 0; i < PWM_CHANNELS; i++) {  // Прогоняем все каналы
    duty[i] = random(0, PWM_DEPTH);             // Заполнение в пределах от 0 до PWM_DEPTH
  }
  delay(100);  // Других задач нет - можно поставить delay (иначе ставим millis() таймер)
}


/*
   Софтверный ШИМ
*/
void pwmTick() {
  static volatile uint8_t counter = 0;  // Счетчик

  if (counter > PWM_DEPTH) {
    // Переполнение счетчика - все каналы ШИМ устанавливаются в HIGH
    for (uint8_t i = 0; i < PWM_CHANNELS; i++) { // Прогоняем все каналы
      if (duty[i] > 0) fastWrite(pins[i], HIGH);  // Если заполнение != 0, ставим пин в HIGH
    }
    counter = 0;                // Обнуляем счетчик ВРУЧНУЮ
  }

  for (uint8_t i = 0; i < PWM_CHANNELS; i++) {        // Прогоняем все каналы
    if (counter == duty[i]) fastWrite(pins[i], LOW); // Если заполнение != 0, ставим пин в HIGH
  }

  counter++;                                          // Инкремент счетчика
}

ISR(TIMER2_A) {
  pwmTick();    // Тикер ШИМ в прерывании таймера (можно перенести код тикера сюда)
}
